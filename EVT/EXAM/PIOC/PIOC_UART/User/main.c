/********************************** (C) COPYRIGHT *******************************
 * File Name          : main.c
 * Author             : WCH
 * Version            : V1.0.0
 * Date               : 2025/5/20
 * Description        : Main program body.
*********************************************************************************
* Copyright (c) 2021 Nanjing Qinheng Microelectronics Co., Ltd.
* Attention: This software (modified or not) and binary are used for
* microcontroller manufactured by Nanjing Qinheng Microelectronics.
*******************************************************************************/
/*
 *@Note
 * PIOC_UART example:
 * PIOC-IO0 ---RX
 * PIOC-IO1 ---TX
 * PIOC_UART is half duplex,the hclk requires 160MHz.
 */
#include "debug.h"
#include "string.h"

void PIOC_IRQHandler(void) __attribute__((interrupt("WCH-Interrupt-fast")));

/* Global define */
#define     UART_SFR_ADDR1  ((uint8_t *)&(PIOC->D8_DATA_REG8))
#define     UART_SFR_ADDR2  ((uint8_t *)&(PIOC->D8_DATA_REG16))
#define  R16_DATA_REG24_25  (*((volatile unsigned short *)(PIOC_SFR_BASE+0x38))) // RW/RW, data buffer 24~25

volatile uint8_t  PIOC_TX_FLAG=0;
volatile uint16_t PIOC_TX_RemainLEN=0;
uint8_t  *PIOC_TX_ADDR;
uint32_t PIOC_baudrate=115200;
uint8_t  PIOC_parity=0;
uint8_t  PIOC_stopbits=0;
uint8_t  PIOC_word_lenth=8;
u8 rx_buf[100]={0};
volatile u8 rx=0;

__attribute__((aligned(16)))  const unsigned char PIOC_CODE[] =
{
    0x00,0x00,0x2B,0x63,0xFF,0x0F,0x00,0x00,0x30,0x00,0x00,0x28,0x07,0x10,0x20,0x02,
    0x06,0x10,0x0B,0x41,0x05,0x01,0x01,0x02,0x1F,0x10,0x23,0x5B,0x3A,0x40,0x05,0x02,
    0x21,0x0C,0x0F,0x38,0x23,0x53,0x3A,0x48,0x00,0x00,0xB8,0x00,0x05,0x01,0x3A,0x02,
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    0x2B,0x63
};

u8 pbuf1[] = {
    0x07, 0x08, 0x09,
    0x0A, 0x0B, 0x0C,
    0x0D, 0x0E, 0x00,
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    0x55,
};
/*********************************************************************
 * @fn      GPIO_Toggle_INIT
 *
 * @brief   Initializes GPIOA.0
 *
 * @return  none
 */
void GPIO_Toggle_INIT(void)
{
    GPIO_InitTypeDef GPIO_InitStructure = {0};

    RCC_PB2PeriphClockCmd(RCC_PB2Periph_GPIOA, ENABLE);
    GPIO_InitStructure.GPIO_Pin = GPIO_Pin_0;
    GPIO_InitStructure.GPIO_Mode = GPIO_Mode_Out_PP;
    GPIO_InitStructure.GPIO_Speed = GPIO_Speed_High;
    GPIO_Init(GPIOA, &GPIO_InitStructure);
}

/*********************************************************************
 * @fn      PIOC_INIT
 *
 * @brief   Initializes PIOC
 *
 * @return  none
 */
void PIOC_INIT(void)
{
    GPIO_InitTypeDef GPIO_InitStructure = {0};

    RCC_PB2PeriphClockCmd(RCC_PB2Periph_AFIO | RCC_PB2Periph_GPIOA, ENABLE);
    RCC_HBPeriphClockCmd(RCC_HBPeriph_PIOC, ENABLE);
	GPIO_PinAFConfig(GPIOA, GPIO_PinSource11, GPIO_AF4);
    GPIO_PinAFConfig(GPIOA, GPIO_PinSource12, GPIO_AF4);
    /* RX PIOC-IO0 */
	GPIO_InitStructure.GPIO_Pin = GPIO_Pin_11;
    GPIO_InitStructure.GPIO_Mode = GPIO_Mode_IPU;
    GPIO_Init(GPIOA, &GPIO_InitStructure);
    /* TX PIOC-IO1 */
    GPIO_InitStructure.GPIO_Pin = GPIO_Pin_12;
    GPIO_InitStructure.GPIO_Mode = GPIO_Mode_AF_PP;
    GPIO_InitStructure.GPIO_Speed = GPIO_Speed_High;
    GPIO_Init(GPIOA, &GPIO_InitStructure);

    NVIC_EnableIRQ( PIOC_IRQn );                                        //enable PIOC interrupt
    NVIC_SetPriority(PIOC_IRQn,0xf0);

    memcpy((uint8_t *)(PIOC_SRAM_BASE),PIOC_CODE,sizeof(PIOC_CODE));    // load code for PIOC
    R8_SYS_CFG |= RB_MST_RESET;                                         // reset PIOC
    R8_SYS_CFG = RB_MST_IO_EN1 | RB_MST_IO_EN0;                         // enable IO0&IO1
    R8_SYS_CFG |= RB_MST_CLK_GATE;                                      // open PIOC clock

}

/*********************************************************************
 * @fn      PIOC_IRQHandler
 *
 * @brief   This function handles PIOC exception.
 *
 * @return  none
 */
void PIOC_IRQHandler( void )
{   
    if((R8_SYS_CFG&RB_INT_REQ)!=RESET)
    {
		//Data reception mode
        if((R8_DATA_REG7 & 0X01) == 0)
        {
            rx_buf[rx++] = R8_DATA_REG31;
        }
        //Data Transmission Mode
        //Double buffering with each buffer size of 8 bytes
        else
        {
            if(PIOC_TX_FLAG==1)
            {
                if(PIOC_TX_RemainLEN<=8)
                {
                    memcpy( UART_SFR_ADDR1, PIOC_TX_ADDR, PIOC_TX_RemainLEN );
                    PIOC_TX_FLAG=0;
                }
                else
                {
                    memcpy( UART_SFR_ADDR1, PIOC_TX_ADDR, 8 );
                    PIOC_TX_ADDR += 8;
                    PIOC_TX_RemainLEN -= 8;
                    PIOC_TX_FLAG=2;
                }
            }
            else if(PIOC_TX_FLAG==2)
            {
                if(PIOC_TX_RemainLEN<=8)
                {
                    memcpy( UART_SFR_ADDR2, PIOC_TX_ADDR, PIOC_TX_RemainLEN );
                    PIOC_TX_FLAG=0;
                }
                else
                {
                    memcpy( UART_SFR_ADDR2, PIOC_TX_ADDR, 8 );
                    PIOC_TX_ADDR += 8;
                    PIOC_TX_RemainLEN -= 8;
                    PIOC_TX_FLAG=1;
                }
            }
        }
        R8_CTRL_RD=11;    // False write any value to R8_CTRL_RD, clear interrupt flag
    }
}

/*********************************************************************
 * @fn      PIOC_UART_INIT
 *
 * @brief   Initializes PIOC_UART.
 *
 * @param   baudrate - 921600,460800,230400,115200,57600,38400,
 *                     19200,14400,9600,4800,2400.
 *          parity - 0: None; 1: Odd; 2: Even; 3: Mark; 4: Space.
 *          stopbits - 0: 1 stop bit; 1: 1.5 stop bit; 2: 2 stop bits
 *          lenth - Data bit length:5,6,7,8
 *
 * @return  none
 */
void PIOC_UART_INIT(uint32_t baudrate,uint8_t parity,uint8_t stopbits,uint8_t lenth)
{
    R8_SYS_CFG |= RB_MST_RESET;                                         // reset PIOC
    R8_SYS_CFG = RB_MST_IO_EN1 | RB_MST_IO_EN0;                         // enable IO0&IO1
    R8_SYS_CFG |= RB_MST_CLK_GATE;                                      // open PIOC clock
    switch(baudrate)
    {
        case 921600: R32_DATA_REG0_3 = 0XE018D725; R32_DATA_REG4_7 = 0X0070F825; break;
        case 460800: R32_DATA_REG0_3 = 0XE02DAB25; R32_DATA_REG4_7 = 0X0030ED25; break;
        case 230400: R32_DATA_REG0_3 = 0XA0595425; R32_DATA_REG4_7 = 0X0010D725; break;
        case 115200: R32_DATA_REG0_3 = 0XF0585324; R32_DATA_REG4_7 = 0X0030AC25; break;
        case  57600: R32_DATA_REG0_3 = 0X70585223; R32_DATA_REG4_7 = 0X00105525; break;
        case  38400: R32_DATA_REG0_3 = 0X0021BF22; R32_DATA_REG4_7 = 0X00007F24; break;
        case  19200: R32_DATA_REG0_3 = 0X00417E22; R32_DATA_REG4_7 = 0X0070F821; break;
        case  14400: R32_DATA_REG0_3 = 0X0016D521; R32_DATA_REG4_7 = 0X00105323; break;
        case   9600: R32_DATA_REG0_3 = 0X0021BF21; R32_DATA_REG4_7 = 0X0000BF22; break;
        case   4800: R32_DATA_REG0_3 = 0X00417E21; R32_DATA_REG4_7 = 0X00707E22; break;
        case   2400: R32_DATA_REG0_3 = 0X0021BF20; R32_DATA_REG4_7 = 0X0070BF21; break;
        default:break;
    }
    switch(parity)
    {
        case 1: R8_DATA_REG3 |= 0X0C; R8_DATA_REG6 |= 0X03; break;
        case 2: R8_DATA_REG3 |= 0X04; R8_DATA_REG6 |= 0X02; break;
        case 3: R8_DATA_REG3 |= 0X0C; R8_DATA_REG6 |= 0X03; R8_DATA_REG7 |= 0X10; break;
        case 4: R8_DATA_REG3 |= 0X04; R8_DATA_REG6 |= 0X02; R8_DATA_REG7 |= 0X10; break;
        default:break;
    }
    switch(stopbits)
    {
        case 1: R8_DATA_REG3 |= 0X01; break;
        case 2: R8_DATA_REG3 |= 0X03; break;
        default:break;
    }
    switch(lenth)
    {
        case 5: R8_DATA_REG7 |= 0X20; break;
        case 6: R8_DATA_REG7 |= 0X40; break;
        case 7: R8_DATA_REG7 |= 0X80; break;
        default:break;
    }
}

/*********************************************************************
 * @fn      PIOC_UART_SEND
 *
 * @brief   Copy data to SFR,with a maximum of 16 bytes at a time,
 *          and the remaining bytes are copied during interrupts.
 *
 * @param   p_source_addr - data.
 *          total_bytes - total data number(byte).
 *
 * @return  none
 */
void PIOC_UART_SEND(uint8_t *p_source_addr,uint16_t total_bytes)
{
    PIOC_UART_INIT(PIOC_baudrate,PIOC_parity,PIOC_stopbits,PIOC_word_lenth);
    if(total_bytes<=16)
    {
        memcpy( UART_SFR_ADDR1, p_source_addr, total_bytes );
        PIOC_TX_FLAG = 0;
        PIOC_TX_RemainLEN = 0;
    }
    else
    {
        memcpy( UART_SFR_ADDR1, p_source_addr, 16 );
        PIOC_TX_FLAG = 1;
        PIOC_TX_RemainLEN = total_bytes-16;
        PIOC_TX_ADDR = p_source_addr+16;
    }
    R16_DATA_REG24_25 = total_bytes;
    R8_DATA_REG7 |= 0X01;           //If the 0th bit of register R8_DATA_REG7 is 1, it indicates the sending mode
    R8_CTRL_WR = 0X33;              // To R8_CTRL_WR write any value,then start
}
/*********************************************************************
 * @fn      main
 *
 * @brief   Main program.
 *
 * @return  none
 */
int main(void)
{
    int i=0;
    int j=0;
    SystemCoreClockUpdate();
    Delay_Init();
    USART_Printf_Init(115200);
    printf("SystemClk:%d\r\n", SystemCoreClock);
    printf( "ChipID:%08x\r\n", DBGMCU_GetCHIPID() );
    printf("GPIO Toggle TEST\r\n");
    GPIO_Toggle_INIT();
    PIOC_INIT();
    PIOC_UART_INIT(PIOC_baudrate,PIOC_parity,PIOC_stopbits,PIOC_word_lenth);
    R8_CTRL_WR = 0X33;                  // To R8_CTRL_WR write any value,then start
    PIOC_UART_SEND(pbuf1,sizeof(pbuf1));
    Delay_Ms(1000);

    while(1)
    {
        if(rx>=30)
        {
            for(j=0;j<30;j++)
            {
                printf("RX DATA:%x\r\n",rx_buf[j]);
            }
            printf("RX STATR:%x\r\n",R8_DATA_REG30);    //0X01: PE  0X02: FE  0X04: NE
            R8_DATA_REG30=0;
            rx=0;
        }
        Delay_Ms(500);
        GPIO_WriteBit(GPIOA, GPIO_Pin_0, (i == 0) ? (i = Bit_SET) : (i = Bit_RESET));
    }
}
